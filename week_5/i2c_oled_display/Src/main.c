/*
 * main.c - SSD1306 OLED over I2C1 (PB8 = SCL, PB9 = SDA)
 * Full 5x7 ASCII font, just change the text in main()
 */

#include "stm32f446xx.h"
#include <stdio.h>

#define OLED_ADDR   0x3C        // 7-bit address, some modules use 0x3D
#define OLED_MAX_CHARS   20U    // characters per line
#define OLED_MAX_LINES   8U     // pages on the screen

static I2C_Handle_t i2c1;


/* ---------- 5x7 font, ASCII 32 (space) to 126 (~) ---------- */

static const uint8_t font5x7[95][5] =
{
    {0x00, 0x00, 0x00, 0x00, 0x00},  // space
    {0x00, 0x00, 0x5F, 0x00, 0x00},  // !
    {0x00, 0x07, 0x00, 0x07, 0x00},  // "
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    {0x10, 0x08, 0x08, 0x10, 0x08},  // ~
};

static const uint8_t blank[5] = {0, 0, 0, 0, 0};

static const uint8_t *get_glyph(char c)
{
    if((c < 32) || (c > 126)) return blank;   // not printable, show a gap

    return font5x7[c - 32];
}


/* ---------- small helpers ---------- */

static void delay(volatile uint32_t n)
{
    while(n--);
}

static void i2c1_gpio_init(void)
{
    GPIO_Handle_t pin;

    GPIO_PeriClockControl(GPIOB, ENABLE);

    pin.pGPIOx = GPIOB;
    pin.GPIO_PinConfig.GPIO_PinMode        = GPIO_MODE_ALTFN;
    pin.GPIO_PinConfig.GPIO_PinAltFunMode  = GPIO_AF4;
    pin.GPIO_PinConfig.GPIO_PinOPType      = GPIO_OP_TYPE_OD;
    pin.GPIO_PinConfig.GPIO_PinPuPdControl = GPIO_PIN_PU;
    pin.GPIO_PinConfig.GPIO_PinSpeed       = GPIO_SPEED_FAST;

    pin.GPIO_PinConfig.GPIO_PinNumber = GPIO_PIN_NO_8;   // SCL
    GPIO_Init(&pin);

    pin.GPIO_PinConfig.GPIO_PinNumber = GPIO_PIN_NO_9;   // SDA
    GPIO_Init(&pin);
}

static void i2c1_init(void)
{
    i2c1.pI2Cx = I2C1;
    i2c1.I2C_Config.I2C_SCLSpeed      = I2C_SCL_SPEED_SM;
    i2c1.I2C_Config.I2C_DeviceAddress = 0x61;            // unused, we are master
    i2c1.I2C_Config.I2C_ACKControl    = I2C_ACK_ENABLE;
    i2c1.I2C_Config.I2C_FMDutyCycle   = I2C_FM_DUTY_2;

    I2C_Init(&i2c1);
    I2C_PeripheralControl(I2C1, ENABLE);
}


/* ---------- OLED ---------- */

// control byte 0x00 = everything after it is a command
static void oled_cmds(const uint8_t *cmds, uint8_t len)
{
    uint8_t buf[32];

    buf[0] = 0x00;
    for(uint8_t i = 0; i < len; i++) buf[i + 1] = cmds[i];

    I2C_MasterSendData(&i2c1, buf, len + 1U, OLED_ADDR, I2C_DISABLE_SR);
}

static void oled_set_cursor(uint8_t page, uint8_t col)
{
    uint8_t c[3];

    c[0] = 0xB0 | page;             // page 0..7
    c[1] = col & 0x0F;              // column low nibble
    c[2] = 0x10 | (col >> 4);       // column high nibble
    oled_cmds(c, 3);
}

static void oled_init(void)
{
    const uint8_t init[] =
    {
        0xAE,           // display off
        0xD5, 0x80,     // clock divide
        0xA8, 0x3F,     // 64 rows
        0xD3, 0x00,     // no vertical offset
        0x40,           // start line 0
        0x8D, 0x14,     // charge pump on
        0x20, 0x02,     // page addressing mode
        0xA1,           // flip horizontally
        0xC8,           // flip vertically
        0xDA, 0x12,     // COM pins
        0x81, 0xCF,     // contrast
        0xD9, 0xF1,     // pre-charge
        0xDB, 0x40,     // VCOM level
        0xA4,           // show RAM content
        0xA6,           // normal (not inverted)
        0xAF            // display on
    };

    oled_cmds(init, sizeof(init));
}

static void oled_clear(void)
{
    uint8_t buf[129] = {0};

    buf[0] = 0x40;                  // control byte 0x40 = data follows

    for(uint8_t page = 0; page < 8; page++)
    {
        oled_set_cursor(page, 0);
        I2C_MasterSendData(&i2c1, buf, 129, OLED_ADDR, I2C_DISABLE_SR);
    }
}

static void oled_print(uint8_t page, uint8_t col, const char *s)
{
    uint8_t  buf[128];
    uint32_t n = 1;

    buf[0] = 0x40;

    while((*s != '\0') && (n <= 120U))
    {
        const uint8_t *g = get_glyph(*s++);

        for(uint8_t i = 0; i < 5; i++) buf[n++] = g[i];
        buf[n++] = 0x00;            // 1 column gap between letters
    }

    oled_set_cursor(page, col);
    I2C_MasterSendData(&i2c1, buf, n, OLED_ADDR, I2C_DISABLE_SR);
}

// prints text wrapped at 20 chars, centered on the screen
static void oled_print_center(const char *s)
{
    uint8_t  start[OLED_MAX_LINES];
    uint8_t  length[OLED_MAX_LINES];
    uint8_t  lines = 0;
    uint32_t pos = 0;
    char     line[OLED_MAX_CHARS + 1];

    /* pass 1: split the text into lines */
    while((s[pos] != '\0') && (lines < OLED_MAX_LINES))
    {
        uint8_t n = 0;

        while(s[pos] == ' ') pos++;             // no leading spaces on a line
        if(s[pos] == '\0') break;

        while((n < OLED_MAX_CHARS) && (s[pos + n] != '\0')) n++;

        if(s[pos + n] != '\0')                  // more text follows, so break at a space
        {
            uint8_t k = n;
            while((k > 0) && (s[pos + k] != ' ')) k--;
            if(k > 0) n = k;                    // no space found: hard break at 20
        }

        while((n > 0) && (s[pos + n - 1] == ' ')) n--;   // trim trailing spaces

        start[lines]  = (uint8_t)pos;
        length[lines] = n;
        lines++;
        pos += n;
    }

    /* pass 2: print each line, centered */
    uint8_t first_page = (uint8_t)((OLED_MAX_LINES - lines) / 2U);

    for(uint8_t i = 0; i < lines; i++)
    {
        for(uint8_t j = 0; j < length[i]; j++) line[j] = s[start[i] + j];
        line[length[i]] = '\0';

        uint8_t col = (uint8_t)((128U - (6U * length[i])) / 2U);

        oled_print(first_page + i, col, line);
    }
}

int main(void)
{
    i2c1_gpio_init();
    i2c1_init();

    delay(500000);                  // let the OLED power up

    oled_init();
    oled_clear();

    oled_print_center("Hello World !");

    while(1);
}
